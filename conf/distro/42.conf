## conf/distro/42.conf
```bitbake
require conf/distro/poky.conf

DISTRO = "42"

DISTRO_NAME = "42 (42 Reference Distro)"
SDK_VENDOR = "-42sdk"

MAINTAINER = "Jean-Pierre Geslin <jgeslin@student.42.fr>"

TARGET_VENDOR = "-42"

LOCALCONF_VERSION  ?= "1"

PACKAGE_CLASSES = "package_deb"

SANITY_TESTED_DISTROS += "42"

# Yocto default features
# acl alsa argp bluetooth ext2 irda largefile pcmcia usbgadget usbhost wifi
# xattr nfs zeroconf pci 3g nfc x11
# Poky default features
# largefile opengl ptest multiarch wayland
DISTRO_FEATURES += " \
  pam \
  systemd \
  vfat \
  virtualization \
  opengl \
  x11 \
  polkit \
  wayland \
  xattr \
"

# disable some default features.
# Default features:
# pulseaudio sysvinit bluez5 gobject-introspection-data ldconfig
DISTRO_FEATURES_BACKFILL_CONSIDERED += " \
  sysvinit \
  pulseaudio \
"

# Set systemd as init manager
VIRTUAL-RUNTIME_init_manager = "systemd"
VIRTUAL-RUNTIME_initscripts = ""

# Remove TMPDIR suffix
TCLIBCAPPEND = ""
hostname_pn-base-files = "42"
INITRAMFS_IMAGE = "42-image-minimal-initramfs"

# Uncomment to enable initramfs
# INITRAMFS_IMAGE_BUNDLE = "1"

PREFERRED_VERSION_grub = "2.%" 

EXTRA_IMAGE_FEATURES += " package-management "
PACKAGE_FEED_URIS = "http://192.168.0.10:18000"
```

## conf/layer.conf
```bitbake
# We have a conf and classes directory, add to BBPATH
BBPATH .= ":${LAYERDIR}"

# We have recipes-* directories, add to BBFILES
BBFILES += "${LAYERDIR}/recipes-*/*/*.bb \
            ${LAYERDIR}/recipes-*/*/*.bbappend"

BBFILE_COLLECTIONS += "meta-42"
BBFILE_PATTERN_meta-42 = "^${LAYERDIR}/"
BBFILE_PRIORITY_meta-42 = "6"

LAYERDEPENDS_meta-42 = "core"
LAYERSERIES_COMPAT_meta-42 = "warrior zeus"
```

## conf/machine/42-qemux86-64.conf
```bitbake
require conf/machine/qemux86-64.conf

PREFERRED_PROVIDER_virtual/kernel = "linux42"
PREFERRED_PROVIDER_virtual/egl = "mesa"
IMAGE_FSTYPES="wic.vmdk"
LICENSE_FLAGS_WHITELIST="commercial"
```
